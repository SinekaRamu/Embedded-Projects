/***************************************************
  Fingerprint attendance system R307-Fingerprint
  module and oled- display.

 ****************************************************/
#include <WiFiClient.h>
#include <ESP8266WiFi.h>
#include <ArduinoJson.h>
#include <ESP8266WebServer.h>
#include <ESP8266HTTPClient.h>

#include <SoftwareSerial.h>
#include <Adafruit_Fingerprint.h> //I2C

#include <SPI.h>
#include <Wire.h>
#include <Adafruit_GFX.h>
#include <Adafruit_SSD1306.h>

#define Finger_Rx 0 // D3
#define Finger_Tx 2 // D4
#define button 14   // D5
#define SCREEN_WIDTH 128
#define SCREEN_HEIGHT 64
#define OLED_RESET 0

Adafruit_SSD1306 display(SCREEN_WIDTH, SCREEN_HEIGHT, &Wire, OLED_RESET);
SoftwareSerial mySerial(Finger_Rx, Finger_Tx);
Adafruit_Fingerprint finger = Adafruit_Fingerprint(&mySerial);

const char *ssid = "Idhaya";
const char *password = "12340005";
uint8_t id;
String postData;
String serverURL = "https://webroid.in/demo/idhayaattendance/users/register.php"; // Replace with your actual server URL
String attendanceURL = "https://webroid.in/demo/idhayaattendance/attendance/mark_attendance.php";

// TESTING
// String attendanceURL = "http://192.168.1.5/biometric/attendance/mark_attendance.php";
// WiFiClient client;

// SECURE
WiFiClientSecure client;
HTTPClient http;

#define Wifi_start_width 54
#define Wifi_start_height 49
const uint8_t PROGMEM Wifi_start_bits[] = {
    0x00, 0x00, 0x00, 0x00, 0x00, 0x00, 0x00, 0x00, 0x00, 0x00, 0x00, 0x00,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 0x00, 0x00};
#define Wifi_connected_width 63
#define Wifi_connected_height 49
const uint8_t PROGMEM Wifi_connected_bits[] = {
    0x00, 0x00, 0x00, 0x00, 0x00, 0x00, 0x00, 0x00, 0x00, 0x00, 0x00, 0x00,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 0x00, 0x00};
#define FinPr_start_width 64
#define FinPr_start_height 64
const uint8_t PROGMEM FinPr_start_bits[] = {
    0x00, 0x00, 0x00, 0x1f, 0xe0, 0x00, 0x00, 0x00, 0x00, 0x00, 0x01, 0xff,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 0x00, 0x00};
#define FinPr_valid_width 64
#define FinPr_valid_height 64
const uint8_t PROGMEM FinPr_valid_bits[] = {
    0x00, 0x00, 0x03, 0xfe, 0x00, 0x00, 0x00, 0x00, 0x00, 0x00, 0x1f, 0xff,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 0x00, 0x00};
#define FinPr_invalid_width 64
#define FinPr_invalid_height 64
const uint8_t PROGMEM FinPr_invalid_bits[] = {
    0x00, 0x00, 0x03, 0xfe, 0x00, 0x00, 0x00, 0x00, 0x00, 0x00, 0x1f, 0xff,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 0x00, 0x00};
#define FinPr_failed_width 64
#define FinPr_failed_height 64
const uint8_t PROGMEM FinPr_failed_bits[] = {
    0x00, 0x00, 0x3f, 0xe0, 0x00, 0x00, 0x00, 0x00, 0x00, 0x01, 0xff, 0xfe,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 0xff, 0xfe};
#define FinPr_scan_width 64
#define FinPr_scan_height 64
const uint8_t PROGMEM FinPr_scan_bits[] = {
    0x00, 0x00, 0x00, 0x00, 0x00, 0x00, 0x00, 0x00, 0x00, 0x00, 0x00, 0x00,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 0x00, 0x00};

void setup()
{
    Serial.begin(115200);

    pinMode(button, INPUT_PULLUP);
    Serial.println("\n\nAdafruit finger detect test");

    if (!display.begin(SSD1306_SWITCHCAPVCC, 0x3C))
    { // Address 0x3D for 128x64
        Serial.println(F("SSD1306 allocation failed"));
        for (;;)
            ; // Don't proceed, loop forever
    }

    display.display();
    delay(500);
    display.clearDisplay();
    connectToWiFi();

    finger.begin(57600);
    delay(5);
    if (finger.verifyPassword())
    {
        Serial.println("Found fingerprint sensor!");
        display.clearDisplay();
        display.drawBitmap(32, 0, FinPr_start_bits, FinPr_start_width, FinPr_start_height, WHITE);
        display.display();
    }
    else
    {
        Serial.println("Did not find fingerprint sensor :(");
        display.clearDisplay();
        display.drawBitmap(32, 0, FinPr_failed_bits, FinPr_failed_width, FinPr_failed_height, WHITE);
        display.display();
        while (1)
        {
            delay(1);
        }
    }

    finger.getTemplateCount();
    Serial.print("Sensor contains ");
    Serial.print(finger.templateCount);
    Serial.println(" templates");
    Serial.println("Waiting for valid finger...");
    // bool val = SendFingerprintID(9);
    // Serial.println(val);
}

void loop()
{
    // check if there's a connection to WiFi or not
    if (WiFi.status() != WL_CONNECTED)
    {
        connectToWiFi();
    }
    getFingerprintID();
    delay(1000);

    if (Serial.available() && (Serial.read() == 'Y'))
    {
        finger.emptyDatabase();
    }

    if (!digitalRead(button))
    {
        Serial.println("Ready to enroll a fingerprint!");
        Serial.println("Please type in the ID # (from 1 to 127) you want to save this finger as...");

        while (!getFingerprintEnroll())
            ;
    }
}

bool MarkAttendance(int finger)
{
    client.setInsecure();

    http.begin(client, attendanceURL);
    http.addHeader("Content-Type", "application/x-www-form-urlencoded");
    String deciveToken = "BioMetric";
    String postData = "device_token=" + String(deciveToken) + "&fingerid=" + String(finger);
    int httpCode = http.POST(postData);
    String response = http.getString();

    Serial.println("HTTP Code: " + String(httpCode));
    Serial.println("Server Response: " + response);

    // **Check for Connection Failure**
    if (httpCode == -1)
    {
        Serial.println("⚠️ Connection failed!");
        DisplayMessage("Conn Failed!", "Retry");
        http.end();
        return false;
    }

    // **Check if the Server Responded**
    if (httpCode != 200)
    {
        Serial.println("⚠️ Server Error: " + String(httpCode));
        DisplayMessage("Server Error", String(httpCode));
        http.end();
        return false;
    }

    // **Parse JSON Response**
    DynamicJsonDocument doc(512);
    DeserializationError error = deserializeJson(doc, response);

    if (error)
    {
        Serial.print("⚠️ JSON Parsing Error: ");
        Serial.println(error.c_str());
        DisplayMessage("JSON Error", "Invalid Data");
        http.end();
        return false;
    }

    // **Extract JSON Values**
    String status = doc["status"].as<String>();
    String message = doc["message"].as<String>();

    // **Display Message on OLED**
    DisplayMessage(status, message);

    http.end(); // **Close HTTP Connection**

    // **Return false if an error occurred**
    return (status != "error");
}

// **OLED Helper Function**
void DisplayMessage(String title, String msg)
{
    display.clearDisplay();
    display.setTextSize(2);
    display.setCursor(0, 0);
    display.print(msg);
    display.display();
    delay(3000);
}

bool SendFingerprintID(int finger)
{
    client.setInsecure();

    http.begin(client, serverURL);
    http.addHeader("Content-Type", "application/x-www-form-urlencoded");

    String postData = "fingerid=" + String(finger);
    int httpCode = http.POST(postData); // Send the request
    String response = http.getString();

    Serial.println("HTTP Code: " + String(httpCode));
    Serial.println("Server Response: " + response);

    if (httpCode == 200)
    {
        // **Parse JSON Response**
        DynamicJsonDocument doc(512); // Adjust buffer size if needed
        DeserializationError error = deserializeJson(doc, response);

        if (error)
        {
            Serial.print("JSON Parsing Error: ");
            Serial.println(error.c_str());
            return false; // Return false if JSON parsing fails
        }

        // **Extract JSON Values**
        String status = doc["status"].as<String>();
        String message = doc["message"].as<String>();

        // **Display JSON Response on OLED**
        if (status == "success")
        {
            display.clearDisplay();
            display.setTextSize(2);
            display.setCursor(0, 10);
            display.print(message);
            display.display();
            delay(5000);
            return true;
        }

        // **Return false if the server response contains an error**
        if (status == "error")
        {
            Serial.println("Error detected in response. Returning false.");
            return false;
        }
    }
    else
    {
        // **Handle HTTP Error**
        return false; // Return false for HTTP errors
    }

    http.end(); // Close connection
    return true;
}

//******************** Validating fingerprint ******************
uint8_t getFingerprintID()
{
    uint8_t p = finger.getImage();
    switch (p)
    {
    case FINGERPRINT_OK:
        // Serial.println("Image taken");
        break;
    case FINGERPRINT_NOFINGER:
        // Serial.println("No finger detected");
        display.clearDisplay();
        display.drawBitmap(32, 0, FinPr_start_bits, FinPr_start_width, FinPr_start_height, WHITE);
        display.display();
        return 0;
    case FINGERPRINT_PACKETRECIEVEERR:
        // Serial.println("Communication error");
        return -2;
    case FINGERPRINT_IMAGEFAIL:
        // Serial.println("Imaging error");
        return -2;
    default:
        // Serial.println("Unknown error");
        return -2;
    }

    // OK success!

    p = finger.image2Tz();
    switch (p)
    {
    case FINGERPRINT_OK:
        // Serial.println("Image converted");
        break;
    case FINGERPRINT_IMAGEMESS:
        // Serial.println("Image too messy");
        return -1;
    case FINGERPRINT_PACKETRECIEVEERR:
        // Serial.println("Communication error");
        return -2;
    case FINGERPRINT_FEATUREFAIL:
        // Serial.println("Could not find fingerprint features");
        return -2;
    case FINGERPRINT_INVALIDIMAGE:
        // Serial.println("Could not find fingerprint features");
        return -2;
    default:
        // Serial.println("Unknown error");
        return -2;
    }

    // OK converted!
    p = finger.fingerSearch();
    if (p == FINGERPRINT_OK)
    {
        // Serial.println("Found a print match!");
        int fingerID = finger.fingerID;
        bool marked = MarkAttendance(fingerID);
        delay(5000);
        if (marked)
        {

            display.clearDisplay();
            display.setTextSize(2);
            display.setTextColor(WHITE);
            display.setCursor(0, 0);
            display.print(fingerID);
            display.drawBitmap(38, 0, FinPr_valid_bits, FinPr_valid_width, FinPr_valid_height, WHITE);
            display.display();
        }
    }
    else if (p == FINGERPRINT_PACKETRECIEVEERR)
    {
        // Serial.println("Communication error");
        return -2;
    }
    else if (p == FINGERPRINT_NOTFOUND)
    {
        Serial.println("Did not find a match");
        display.clearDisplay();
        display.drawBitmap(34, 0, FinPr_invalid_bits, FinPr_invalid_width, FinPr_invalid_height, WHITE);
        display.display();
        return -1;
    }
    else
    {
        // Serial.println("Unknown error");
        return -2;
    }

    // found a match!
    Serial.print("Found ID #");
    Serial.print(finger.fingerID);
    Serial.print(" with confidence of ");
    Serial.println(finger.confidence);

    return finger.fingerID;
}

//******************** enrolling fringerprint ******************
uint8_t getFingerprintEnroll()
{

    int p = -1;
    display.clearDisplay();
    display.drawBitmap(34, 0, FinPr_scan_bits, FinPr_scan_width, FinPr_scan_height, WHITE);
    display.display();
    Serial.print("Waiting for valid finger to enroll as #");
    Serial.println(id);
    while (p != FINGERPRINT_OK)
    {
        p = finger.getImage();
        switch (p)
        {
        case FINGERPRINT_OK:
            // display.clearDisplay();
            // display.drawBitmap( 34, 0, FinPr_valid_bits, FinPr_valid_width, FinPr_valid_height, WHITE);
            // display.display();
            break;
        case FINGERPRINT_NOFINGER:
            display.setTextSize(1);      // Normal 2:2 pixel scale
            display.setTextColor(WHITE); // Draw white text
            display.setCursor(0, 0);     // Start at top-left corner
            display.print(F("scanning"));
            display.display();
            break;
        case FINGERPRINT_PACKETRECIEVEERR:
            display.clearDisplay();
            display.drawBitmap(34, 0, FinPr_invalid_bits, FinPr_invalid_width, FinPr_invalid_height, WHITE);
            display.display();
            break;
        case FINGERPRINT_IMAGEFAIL:
            Serial.println("Imaging error");
            break;
        default:
            Serial.println("Unknown error");
            break;
        }
    }

    // OK success!

    p = finger.image2Tz(1);
    switch (p)
    {
    case FINGERPRINT_OK:
        // display.clearDisplay();
        // display.drawBitmap( 34, 0, FinPr_valid_bits, FinPr_valid_width, FinPr_valid_height, WHITE);
        // display.display();
        break;
    case FINGERPRINT_IMAGEMESS:
        display.clearDisplay();
        display.drawBitmap(34, 0, FinPr_invalid_bits, FinPr_invalid_width, FinPr_invalid_height, WHITE);
        display.display();
        return p;
    case FINGERPRINT_PACKETRECIEVEERR:
        Serial.println("Communication error");
        return p;
    case FINGERPRINT_FEATUREFAIL:
        Serial.println("Could not find fingerprint features");
        return p;
    case FINGERPRINT_INVALIDIMAGE:
        Serial.println("Could not find fingerprint features");
        return p;
    default:
        Serial.println("Unknown error");
        return p;
    }
    display.clearDisplay();
    display.setTextSize(2);      // Normal 2:2 pixel scale
    display.setTextColor(WHITE); // Draw white text
    display.setCursor(0, 0);     // Start at top-left corner
    display.print(F("Remove"));
    display.setCursor(0, 20);
    display.print(F("finger"));
    display.display();
    delay(2000);
    p = 0;
    while (p != FINGERPRINT_NOFINGER)
    {
        p = finger.getImage();
    }
    Serial.print("ID ");
    Serial.println(id);
    p = -1;
    display.clearDisplay();
    display.drawBitmap(34, 0, FinPr_scan_bits, FinPr_scan_width, FinPr_scan_height, WHITE);
    display.display();
    while (p != FINGERPRINT_OK)
    {
        p = finger.getImage();
        switch (p)
        {
        case FINGERPRINT_OK:
            // display.clearDisplay();
            // display.drawBitmap( 34, 0, FinPr_valid_bits, FinPr_valid_width, FinPr_valid_height, WHITE);
            // display.display();
            break;
        case FINGERPRINT_NOFINGER:
            display.setTextSize(1);      // Normal 2:2 pixel scale
            display.setTextColor(WHITE); // Draw white text
            display.setCursor(0, 0);     // Start at top-left corner
            display.print(F("scanning"));
            display.display();
            break;
        case FINGERPRINT_PACKETRECIEVEERR:
            Serial.println("Communication error");
            break;
        case FINGERPRINT_IMAGEFAIL:
            Serial.println("Imaging error");
            break;
        default:
            Serial.println("Unknown error");
            break;
        }
    }

    // OK success!

    p = finger.image2Tz(2);
    switch (p)
    {
    case FINGERPRINT_OK:
        // display.clearDisplay();
        // display.drawBitmap( 34, 0, FinPr_valid_bits, FinPr_valid_width, FinPr_valid_height, WHITE);
        // display.display();
        break;
    case FINGERPRINT_IMAGEMESS:
        Serial.println("Image too messy");
        return p;
    case FINGERPRINT_PACKETRECIEVEERR:
        Serial.println("Communication error");
        return p;
    case FINGERPRINT_FEATUREFAIL:
        Serial.println("Could not find fingerprint features");
        return p;
    case FINGERPRINT_INVALIDIMAGE:
        Serial.println("Could not find fingerprint features");
        return p;
    default:
        Serial.println("Unknown error");
        return p;
    }

    // OK converted!
    Serial.print("Creating model for #");
    Serial.println(id);

    p = finger.createModel();
    if (p == FINGERPRINT_OK)
    {
        // Serial.println("Prints matched!");
        display.clearDisplay();
        // display.drawBitmap( 34, 0, FinPr_valid_bits, FinPr_valid_width, FinPr_valid_height, WHITE);
        display.drawBitmap(32, 0, FinPr_failed_bits, FinPr_failed_width, FinPr_failed_height, WHITE);

        display.display();
    }
    else if (p == FINGERPRINT_PACKETRECIEVEERR)
    {
        Serial.println("Communication error");
        return p;
    }
    else if (p == FINGERPRINT_ENROLLMISMATCH)
    {
        Serial.println("Fingerprints did not match");
        return p;
    }
    else
    {
        Serial.println("Unknown error");
        return p;
    }

    id = finger.templateCount + 1;
    p = finger.storeModel(id);
    Serial.print("ID ");
    Serial.println(id);

    if (p == FINGERPRINT_OK)
    {
        Serial.println("Stored!");
        bool store = SendFingerprintID(id);
        while (store == 0)
        {
            Serial.println(store);
            display.clearDisplay();
            display.setTextSize(2);  // Normal 1:1 pixel scale
            display.setCursor(0, 0); // Start at top-left corner
            display.print(F("ID: "));
            display.setCursor(0, 50); // Start at top-left corner
            display.print(id);
            display.drawBitmap(34, 0, FinPr_valid_bits, FinPr_valid_width, FinPr_valid_height, WHITE);
            display.display();
            delay(10000);
            store = SendFingerprintID(id);
        }
    }
    else if (p == FINGERPRINT_PACKETRECIEVEERR)
    {
        Serial.println("Communication error");
        --id;
        return p;
    }
    else if (p == FINGERPRINT_BADLOCATION)
    {
        Serial.println("Could not store in that location");
        --id;
        return p;
    }
    else if (p == FINGERPRINT_FLASHERR)
    {
        Serial.println("Error writing to flash");
        --id;
        return p;
    }
    else
    {
        Serial.println("Unknown error");
        --id;
        return p;
    }

    return true;
}

//********************connect to the WiFi******************
void connectToWiFi()
{
    WiFi.mode(WIFI_OFF); // Prevents reconnection issue (taking too long to connect)
    delay(1000);
    WiFi.mode(WIFI_STA);
    Serial.print("Connecting to ");
    Serial.println(ssid);
    WiFi.begin(ssid, password);

    display.clearDisplay();
    display.setTextSize(1);      // Normal 1:1 pixel scale
    display.setTextColor(WHITE); // Draw white text
    display.setCursor(0, 0);     // Start at top-left corner
    display.print(F("Connecting to \n"));
    display.setCursor(0, 50);
    display.setTextSize(2);
    display.print(ssid);
    display.drawBitmap(73, 10, Wifi_start_bits, Wifi_start_width, Wifi_start_height, WHITE);
    display.display();

    while (WiFi.status() != WL_CONNECTED)
    {
        delay(500);
        Serial.print(".");
    }
    Serial.println("");
    Serial.println("Connected");

    display.clearDisplay();
    display.setTextSize(2);      // Normal 1:1 pixel scale
    display.setTextColor(WHITE); // Draw white text
    display.setCursor(8, 0);     // Start at top-left corner
    display.print(F("Connected \n"));
    display.drawBitmap(33, 15, Wifi_connected_bits, Wifi_connected_width, Wifi_connected_height, WHITE);
    display.display();

    Serial.print("IP address: ");
    Serial.println(WiFi.localIP()); // IP address assigned to your ESP
}
